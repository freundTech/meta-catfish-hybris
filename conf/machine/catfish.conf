## conf/machine/catfish.conf
```bitbake
#@TYPE: Machine
#@NAME: Ticwatch Pro
#@DESCRIPTION: Machine configuration for the Ticwatch Pro

require conf/machine/include/tune-cortexa7.inc
require conf/machine/include/hybris-watch.inc

MACHINE_DISPLAY_ROUND = "true"
MACHINE_HAS_WLAN = "true"

PREFERRED_VERSION_android = "pie"
# Ticwatch Pro (catfish) uses the Ticwatch Pro 4G (catshark) kernel
PREFERRED_PROVIDER_virtual/kernel = "linux-catshark"
PREFERRED_VERSION_linux = "3.18+pie"

IMAGE_INSTALL += "android-tools android-system underclock msm-fb-refresher asteroid-compass"
```
